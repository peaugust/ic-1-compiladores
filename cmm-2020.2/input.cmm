def fib(n) {
    if n == 1 return 1;
    return fib(n-1);
}

def hello(n) {
    return (n);
}

def main() {
    switch (a)
        case 1:
            print hello(1);
            break;
        default:
            print hello(2);
            break;
}
