class TestClass {
def init(n) {
    if n == 1 return 1;
    if n == 2 return 1;
    varlorString = "testeString";
    varlorPontoFlutuante = 12.5;
    valorBooleano = 'false';
    return fib(n-1)+fib(n-2);
}

def main() {
    a = 10;
    b = false;
    c = true;
    do {
        print fib(input);
        } while a ;
    return 0;
}

a = 5;

def test() {
    return 6;
}

j = 5;
a = TestClass(j);
