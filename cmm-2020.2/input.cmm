def fib(n) {
    if n == 1 return 1;
    if n == 2 return 1;
    varlorString = "testeString";
    varlorPontoFluturante = 12.5;
    valorBloeano = 'false';
    return fib(n-1)+fib(n-2);
}
def main() {
    a = 10;
    b = false;
    c = true;
    while a {
        print fib(input);
        a = a-1;
    }
    return 0;
}
