class TestClass {
    def init(n) {
        if n == 1 return 1;
        if n == 2 return 1;
        varlorString = "testeString";
        varlorPontoFlutuante = 12.5;
        valorBooleano = 'false';
        return fib(n-1)+fib(n-2);
    }
}

def main() {
    a = 10;
    b = false;
    c = true;
    do {
        print fib(input);
        } while a ;
    return 0;
}

a = 5;

def test() {
    return 6;
}

j = 5;
a = TestClass(j);

def hello(n) {
    return (n);
}

def switch() {
    switch (a)
        case 1:
            print hello(1);
            break;
        default:
            print hello(2);
            break;
}

def switchFunc3() {
    switch (a)
        case 1:
            print hello(1)
            break
        default:
            print hello(2)
            break
}

def switchFunc {
    switch (a)
        case 1:
            print hello(1);
            break;
        default:
            print hello(2);
            break;
}
